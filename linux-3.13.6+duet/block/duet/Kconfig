## linux-3.13.6+duet/block/duet/Kconfig
```kconfig
config DUET
	bool "Core Duet synergy framework support"

	help
	  Duet is a framework aiming to reduce the IO needed for maintenance
	  work. By exposing page cache events to maintenance tasks, it allows
	  them to detect synergies with other processes, and leverage them to
	  perform maintenance work opportunistically, out of order, while the
	  data is available in the page cache. In the core of the duet system
	  lie hooks into the page cache layer, that inform the framework on
	  the addition or removal of pages from the page cache.

	  To compile duet support as a module, choose M here. The module will
	  be called duet.

	  If unsure, say N.

config DUET_STATS
	bool "Duet stats support"
	depends on DUET

	help
	  This option enabled support for keeping statistics about the data
	  structures used internally.

	  If unsure, say N.

config DUET_DEBUG
	bool "Duet debugging support"
	depends on DUET
	help
	  Enable run-time debugging support for the duet framework. This may
	  enable additional and expensive checks with negative impact on
	  performance, or export extra information via sysfs.

	  If unsure, say N.
```

## linux-3.13.6+duet/fs/btrfs/Kconfig
```kconfig
config BTRFS_FS
	tristate "Btrfs filesystem support"
	select LIBCRC32C
	select ZLIB_INFLATE
	select ZLIB_DEFLATE
	select LZO_COMPRESS
	select LZO_DECOMPRESS
	select RAID6_PQ
	select XOR_BLOCKS

	help
	  Btrfs is a general purpose copy-on-write filesystem with extents,
	  writable snapshotting, support for multiple devices and many more
	  features focused on fault tolerance, repair and easy administration.

	  The filesystem disk format is no longer unstable, and it's not
	  expected to change unless there are strong reasons to do so. If there
	  is a format change, file systems with a unchanged format will
	  continue to be mountable and usable by newer kernels.

	  For more information, please see the web pages at
	  http://btrfs.wiki.kernel.org.

	  To compile this file system support as a module, choose M here. The
	  module will be called btrfs.

	  If unsure, say N.

config BTRFS_FS_POSIX_ACL
	bool "Btrfs POSIX Access Control Lists"
	depends on BTRFS_FS
	select FS_POSIX_ACL
	help
	  POSIX Access Control Lists (ACLs) support permissions for users and
	  groups beyond the owner/group/world scheme.

	  To learn more about Access Control Lists, visit the POSIX ACLs for
	  Linux website <http://acl.bestbits.at/>.

	  If you don't know what Access Control Lists are, say N

config BTRFS_FS_CHECK_INTEGRITY
	bool "Btrfs with integrity check tool compiled in (DANGEROUS)"
	depends on BTRFS_FS
	help
	  Adds code that examines all block write requests (including
	  writes of the super block). The goal is to verify that the
	  state of the filesystem on disk is always consistent, i.e.,
	  after a power-loss or kernel panic event the filesystem is
	  in a consistent state.

	  If the integrity check tool is included and activated in
	  the mount options, plenty of kernel memory is used, and
	  plenty of additional CPU cycles are spent. Enabling this
	  functionality is not intended for normal use.

	  In most cases, unless you are a btrfs developer who needs
	  to verify the integrity of (super)-block write requests
	  during the run of a regression test, say N

menu "Btrfs maintenance tasks"

choice
	prompt "Btrfs scrubbing with I/O throttling (NEW)"
	default BTRFS_FS_SCRUB_NONE

config BTRFS_FS_SCRUB_NONE
	bool "No throttling"
	depends on BTRFS_FS
	help
	  This is the stock scrubber currently shipped with btrfs. Once a scrub
	  is initiated from the btrfs tools command, it proceeds at full speed
	  (unless throttled using a low IO priority), utilizing a fixed number
	  of bios that can be in flight at any time. This puts an upper bound
	  and how much disk bandwidth will be consumed, but the bound is
	  hardcoded.

	  Downside: Aggressive bandwidth consumption by the scrubber.

config BTRFS_FS_SCRUB_ADAPT
	bool "Adaptive throttling"
	depends on BTRFS_FS
	help
	  Adds code that enforces adaptive I/O throttling for the btrfs
	  scrubber. With the updated version of the btrfs tools, you can
	  specify a deadline for the scrubber (-D). Then, the scrubber will
	  adapt the number of bios in flight, as well as the delays introduced
	  between them throughout the scrub, in order to meet the predefined
	  deadline. This approach takes into account possible slowdowns due to
	  foreground workload requests.
endchoice

config BTRFS_FS_MAPPING
	bool "Btrfs mapping code"
	depends on BTRFS_FS
	help
	  Enables mapping of physical address ranges to logical ones.
	  Also enables mapping of logical address ranges to physical ones.
	  Supports discontiguous physical spaces, such as those caused by
	  RAID arrays. Does not account for compression (yet).

config BTRFS_FS_MAPPING_DEBUG
	bool "Btrfs mapping code debug messages"
	depends on BTRFS_FS
	depends on BTRFS_FS_MAPPING
	help
	  Enables debugging messages for the btrfs mapping code from
	  logical-to-physical and physical-to-logical.

	  If unsure/not a developer, say N here.

config BTRFS_DUET_SCRUB
	bool "Duet framework support for the btrfs scrubber"
	depends on BTRFS_FS
	select DUET
	select DUET_FS
	select BTRFS_FS_MAPPING
	help
	  Adds support for the btrfs scrubber to collaborate with other tasks
	  through the duet framework

config BTRFS_DUET_SCRUB_DEBUG
	bool "Debugging support for the opportunistic btrfs scrubber"
	depends on BTRFS_FS
	select DUET
	select DUET_FS
	select BTRFS_DUET_SCRUB
	help
	  Adds debugging support for the opportunistic btrfs scrubber

config BTRFS_FS_SCRUB_BOOST
	bool "Btrfs scrubbing boost capability (EXPERIMENTAL)"
	depends on BTRFS_FS_SCRUB_ADAPT
	help
	  Enables boosting functionality for the btrfs scrubber.

config BTRFS_FS_SCRUB_READA
	bool "Btrfs scrubbing enhanced readahead (EXPERIMENTAL)"
	depends on BTRFS_FS_SCRUB_ADAPT
	select DUET
	select DUET_FS
	help
	  Enables enhanced readahead functionality for the btrfs scrubber.

config BTRFS_FS_SCRUB_DEBUG
	bool "Btrfs scrubbing debug messages"
	depends on BTRFS_FS
	help
	  Enables debugging messages for the btrfs scrubber.

	  If unsure/not a developer, say N here.

config BTRFS_DUET_BACKUP
	bool "Duet framework support for the btrfs backup (send/receive)"
	depends on BTRFS_FS
	select DUET
	select DUET_FS
	select BTRFS_FS_MAPPING
	help
	  Adds support for the btrfs backup (send/receive) to collaborate with
	  other tasks through the duet framework

config BTRFS_DUET_BACKUP_DEBUG
	bool "Debug messages for the synergistic btrfs backup (send/receive)"
	depends on BTRFS_FS
	depends on BTRFS_DUET_BACKUP
	help
	  Adds debug messages for the synergistic btrfs backup.

	  If unsure/not a developer, say N here.

config BTRFS_DEFRAG
	bool "Btrfs filesystem-wide defrag support"
	depends on BTRFS_FS
	help
	  Adds support for a filesystem-wide defrag

config BTRFS_DUET_DEFRAG
	bool "Duet framework support for the btrfs defrag"
	depends on BTRFS_FS
	select DUET
	select DUET_CACHE
	select BTRFS_DEFRAG
	select BTRFS_FS_MAPPING
	help
	  Adds support for the btrfs defrag to collaborate with other tasks
	  through the duet framework

config BTRFS_DUET_DEFRAG_DEBUG
	bool "Debug messages for the synergistic btrfs defrag"
	depends on BTRFS_FS
	depends on BTRFS_DUET_DEFRAG
	help
	  Adds debug messages for the synergistic btrfs defrag.

	  If unsure/not a developer, say N here.

config BTRFS_DUET_DEFRAG_CPUMON
	bool "Report CPU time spent updating the RBIT"
	depends on BTRFS_FS
	depends on BTRFS_DUET_DEFRAG
	help
	  Monitors and reports the total cpu time spent updating the red-black
	  inode tree used by the synergistic btrfs defrag. The total time is
	  printed to syslog on completion of the defrag run.

	  If unsure/not a developer, say N here.

endmenu

config BTRFS_FS_RUN_SANITY_TESTS
	bool "Btrfs will run sanity tests upon loading"
	depends on BTRFS_FS
	help
	  This will run some basic sanity tests on the free space cache
	  code to make sure it is acting as it should.  These are mostly
	  regression tests and are only really interesting to btrfs
	  developers.

	  If unsure, say N.

config BTRFS_DEBUG
	bool "Btrfs debugging support"
	depends on BTRFS_FS
	help
	  Enable run-time debugging support for the btrfs filesystem. This may
	  enable additional and expensive checks with negative impact on
	  performance, or export extra information via sysfs.

	  If unsure, say N.

config BTRFS_ASSERT
	bool "Btrfs assert support"
	depends on BTRFS_FS
	help
	  Enable run-time assertion checking.  This will result in panics if
	  any of the assertions trip.  This is meant for btrfs developers only.

	  If unsure, say N.
```

## linux-3.13.6+duet/fs/f2fs/Kconfig
```kconfig
config F2FS_FS
	tristate "F2FS filesystem support (EXPERIMENTAL)"
	depends on BLOCK
	help
	  F2FS is based on Log-structured File System (LFS), which supports
	  versatile "flash-friendly" features. The design has been focused on
	  addressing the fundamental issues in LFS, which are snowball effect
	  of wandering tree and high cleaning overhead.

	  Since flash-based storages show different characteristics according to
	  the internal geometry or flash memory management schemes aka FTL, F2FS
	  and tools support various parameters not only for configuring on-disk
	  layout, but also for selecting allocation and cleaning algorithms.

	  If unsure, say N.

config F2FS_STAT_FS
	bool "F2FS Status Information"
	depends on F2FS_FS && DEBUG_FS
	default y
	help
	  /sys/kernel/debug/f2fs/ contains information about all the partitions
	  mounted as f2fs. Each file shows the whole f2fs information.

	  /sys/kernel/debug/f2fs/status includes:
	    - major file system information managed by f2fs currently
	    - average SIT information about whole segments
	    - current memory footprint consumed by f2fs.

config F2FS_DUET_STAT
	bool "F2FS Duet Stats"
	depends on F2FS_FS && DEBUG_FS
	select F2FS_STAT_FS
	help
	  Include Duet-related statistics in /sys/kernel/debug/f2fs/status

config F2FS_FS_XATTR
	bool "F2FS extended attributes"
	depends on F2FS_FS
	default y
	help
	  Extended attributes are name:value pairs associated with inodes by
	  the kernel or by users (see the attr(5) manual page, or visit
	  <http://acl.bestbits.at/> for details).

	  If unsure, say N.

config F2FS_FS_POSIX_ACL
	bool "F2FS Access Control Lists"
	depends on F2FS_FS_XATTR
	select FS_POSIX_ACL
	default y
	help
	  Posix Access Control Lists (ACLs) support permissions for users and
	  gourps beyond the owner/group/world scheme.

	  To learn more about Access Control Lists, visit the POSIX ACLs for
	  Linux website <http://acl.bestbits.at/>.

	  If you don't know what Access Control Lists are, say N

config F2FS_FS_SECURITY
	bool "F2FS Security Labels"
	depends on F2FS_FS_XATTR
	help
	  Security labels provide an access control facility to support Linux
	  Security Models (LSMs) accepted by AppArmor, SELinux, Smack and TOMOYO
	  Linux. This option enables an extended attribute handler for file
	  security labels in the f2fs filesystem, so that it requires enabling
	  the extended attribute support in advance.

	  If you are not using a security module, say N.

config F2FS_CHECK_FS
	bool "F2FS consistency checking feature"
	depends on F2FS_FS
	help
	  Enables BUG_ONs which check the file system consistency in runtime.

	  If you want to improve the performance, say N.

config F2FS_DUET_GC
	bool "F2FS opportunistic segment cleaning with Duet"
	depends on F2FS_FS
	select DUET
	select DUET_CACHE
	help
	  Enables opportunistic segment cleaning with the Duet maintenance
	  framework.

config F2FS_DUET_DEBUG
	bool "F2FS Duet messages"
	depends on F2FS_FS
	select F2FS_DUET_GC
	select F2FS_DUET_STAT
	help
	  Enables Duet debug messages
```
